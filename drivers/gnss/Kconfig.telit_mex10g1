## drivers/gnss/Kconfig.telit_mex10g1
```kconfig
config GNSS_TELIT_MEX10G1
	bool "Telit MEX10G1 GNSS device"
	default y
	depends on GNSS
	depends on DT_HAS_TELIT_MEX10G1_ENABLED
    depends on CELLULAR_MODEM
	select MODEM_MODULES
	select MODEM_BACKEND_UART
	select MODEM_CHAT
	select GNSS_PARSE
	select GNSS_NMEA0183
	select GNSS_NMEA0183_MATCH
	help
	  "Enable Telit MEX10G1 GNSS driver. Currently, This only works in data mode which depends on the Telit cellular modem driver spinning up the necessary resources and sending the modem the +CMUX command"
```

## dts/bindings/gnss/telit,mex10g1-gnss.yaml
```yaml
description: Telit MEX10G1 GNSS modem

compatible: "telit,mex10g1-gnss"

include:
  - uart-device.yaml
```
